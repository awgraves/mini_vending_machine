## modules/joystick/drivers/joystick/Kconfig
```kconfig
config JOYSTICK
  bool "Joystick"
  default n
  depends on ADC
  help
    Enable custom joystick driver.
```

## modules/joystick/dts/bindings/joystick.yaml
```yaml
description: Analog joystick with x/y potentiometers connected to ADC channels
compatible: joystick

include: base.yaml

properties:
  io-channels:
    type: phandle-array
    required: true
  io-channel-names:
    type: string-array
    required: true
```

## west.yml
```yaml
manifest:
  remotes:
    - name: zephyrproject-rtos
      url-base: https://github.com/zephyrproject-rtos
  projects:
    - name: zephyr
      remote: zephyrproject-rtos
      revision: v4.4.2
      clone-depth: 1
      import:
        name-allowlist:
          - cmsis
          - hal_stm32
          - cmsis_6
  self:
    path: .
```
