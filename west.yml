## west.yml
```yaml
manifest:
  remotes:
    - name: zephyrproject-rtos
      url-base: https://github.com/zephyrproject-rtos
  projects:
    - name: zephyr
      remote: zephyrproject-rtos
      revision: v4.4.2
      clone-depth: 1
      import:
        name-allowlist:
          - cmsis
          - cmsis_6
          - hal_stm32
          - hal_espressif
  self:
    path: .
```
